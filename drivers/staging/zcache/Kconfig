## drivers/staging/zcache/Kconfig
```kconfig
config ZCACHE
	bool "Page cache compression support"
	depends on CLEANCACHE
	select XVMALLOC
	select LZO_COMPRESS
	select LZO_DECOMPRESS
	default n
	help
	  Compresses relatively unused page cache pages and stores them in
	  memory itself. This increases effective memory size and can help
	  reduce access to backing store device(s) which is typically much
	  slower than access to main memory.

	  Statistics are expoted through sysfs interface:
	  /sys/kernel/mm/zcache/

	  Project home: http://compcache.googlecode.com/
```

## drivers/staging/zram/Kconfig
```kconfig
config XVMALLOC
       bool "ZRAM XVMALLOCATOR"
       default n
       help
	This helps to ZRAM and Zcache to work with RAM.

config ZRAM
        tristate "Compressed in-memory swap device (zram)"
        depends on SWAP
        select LZO_COMPRESS
        select LZO_DECOMPRESS
	select XVMALLOC
        default n
        help
          Creates virtual block devices which can be used as swap
          disks, or virtual hard disk based on RAM
	  Pages swapped to these disks are compressed and stored in
          memory itself.

          Project home: http://compcache.googlecode.com/
```

## drivers/video/msm/Kconfig
```kconfig
config FB_MSM
	tristate "MSM Framebuffer"
	depends on FB && ARCH_MSM
	select FB_CFB_FILLRECT
	select FB_CFB_COPYAREA
	select FB_CFB_IMAGEBLIT
	default y

config FB_MSM_MDP_PPP
	bool "MSM MDP PPP"
	depends on FB_MSM_LEGACY_MDP
	default y

config FB_MSM_LCDC
	bool "Support for integrated LCD controller in MDP3/4"
	depends on FB_MSM && (MSM_MDP31 || MSM_MDP302 || MSM_MDP40)
	default y

config FB_MSM_MDDI
	bool "Support for MSM MDDI controllers"
	depends on FB_MSM
	default y

config FB_MSM
	tristate
	depends on FB && ARCH_MSM
	select FB_CFB_FILLRECT
	select FB_CFB_COPYAREA
	select FB_CFB_IMAGEBLIT
	default y

config FB_MSM_LEGACY_MDP
	bool "MSM Legacy MDP (qsd8k)"
	depends on FB_MSM && (MSM_MDP30 || MSM_MDP31 || MSM_MDP302)
	default y

config FB_MSM_MDP_PPP
	bool "MSM MDP PPP"
	depends on FB_MSM_LEGACY_MDP
	default y

config FB_MSM_LCDC
	bool "Support for integrated LCD controller in qsd8x50 ,MSM7x27 and MSM7x30"
	depends on FB_MSM && (MSM_MDP31 || MSM_MDP302 || MSM_MDP40)
	default y

config FB_MSM_MDDI
	bool "Support for MSM MDDI controllers"
	depends on FB_MSM
	default y

config FB_MSM_MDDI_EPSON
	bool "Support for Epson MDDI panels"
	depends on FB_MSM_MDDI
	default n

config FB_MSM_MDDI_NOVTEC
	bool "Support for Novtec MDDI panels"
	depends on FB_MSM_MDDI
	default n

config MSM_ROTATOR
        tristate "MSM Offline Image Rotator Driver"
        depends on ARCH_MSM7X30 && ANDROID_PMEM
        default y
        help
          This driver provides support for the image rotator HW block in the
          MSM 7x30 SoC.

config MSM_ROTATOR_USE_IMEM
        bool "Enable rotator driver to use iMem"
        depends on MSM_ROTATOR
        default y
        help
          This option enables the msm_rotator driver to use the move efficient
          iMem.  Some MSM platforms may not have iMem available for the rotator
          block.  Or some systems may want the iMem to be dedicated to a
          different function.

config MSM_HDMI
	bool "Support for HDMI in QCT platform"
	depends on MSM_MDP31
	default n

config FB_MSM_LOGO
       bool "Use boot splashscreen"
       depends on FB_MSM
       default y
       help
        Use logo.rle splash screen at startup
```
